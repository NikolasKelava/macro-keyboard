## firmware/config/boards/arm/macro_keyboard/Kconfig.defconfig
```kconfig
if BOARD_MACRO_KEYBOARD

config BOARD
    default "macro_keyboard"

config ZMK_KEYBOARD_NAME
    default "Macro Keyboard"

config BT_CTLR
    default BT

config ZMK_BLE
    default y

config ZMK_USB
    default y

if USB_DEVICE_STACK

config USB_NRFX
    default y

endif # USB_DEVICE_STACK

config ZMK_BATTERY_VOLTAGE_DIVIDER
    default y

# ZMK Studio (enable in .conf and install protobuf for configurator)
config ZMK_STUDIO
    default n

endif # BOARD_MACRO_KEYBOARD
```

## firmware/config/boards/arm/macro_keyboard/board.yml
```yaml
board:
  name: macro_keyboard
  vendor: macro
  socs:
    - name: nrf52840
      variants:
        - name: qiaa
```

## firmware/zmk-config/module/drivers/sensor/as5600/Kconfig
```kconfig
# Copyright (c) 2026 The ZMK Contributors
# SPDX-License-Identifier: MIT

menuconfig AS5600
    bool "AS5600 magnetic rotary encoder (polled I2C keymap sensor)"
    default y
    depends on DT_HAS_NIKOLAS_AS5600_ENABLED
    depends on I2C
    help
      Driver for the AS5600 12-bit magnetic angle sensor used as a ZMK keymap
      encoder. Polls the RAW ANGLE register over I2C on its own thread and
      reports rotation deltas (in degrees) on SENSOR_CHAN_ROTATION.

if AS5600

config AS5600_THREAD_STACK_SIZE
    int "AS5600 poll thread stack size"
    default 2048
    help
      The poll thread is the context in which ZMK raises the sensor event and
      synchronously runs the bound behaviour chain (key press / scroll), so it
      needs enough headroom for that whole call depth — 1024 was marginal.

config AS5600_THREAD_PRIORITY
    int "AS5600 poll thread priority"
    default 10
    help
      Preemptible priority of the polling thread. The thread sleeps between
      reads, so a low priority is fine.

config AS5600_STARTUP_DELAY_MS
    int "AS5600 startup delay (ms)"
    default 1000
    help
      Delay before the poll thread first touches the (shared) I2C bus, giving
      the OLED, BLE and USB time to finish initialising first.

config AS5600_SMOOTHING_SHIFT
    int "AS5600 low-pass smoothing (alpha = 1/2^SHIFT)"
    default 1
    help
      Strength of the wrap-aware EMA applied to the raw angle. 0 disables it
      (raw passthrough); 1 = alpha 1/2 (light); 2 = alpha 1/4 (more). Higher
      values smooth more but add a little latency. Light smoothing lets the
      deadband below be smaller without spurious events creeping back.

config AS5600_DEADBAND_COUNTS
    int "AS5600 stillness deadband (12-bit counts)"
    default 4
    help
      Movement within this many counts of the reference angle is treated as
      sensor jitter, not motion. Stops the still magnet's angle noise from
      raising spurious sensor events that would keep ZMK from going idle (so the
      display blanks and the board can deep-sleep). Raise it if the display
      still won't blank at rest; lower it if very slow turns feel unresponsive.

endif # AS5600
```

## firmware/zmk-config/module/dts/bindings/behaviors/zmk,behavior-encoder-dispatch.yaml
```yaml
description: |
  Encoder dispatch sensor behavior. Bound as a layer's sensor-binding (zero
  cells). On each tick it reads the current profile's encoder mode at runtime
  and emits the matching action: volume keys (&kp), vertical/horizontal scroll
  (&msc), or browser tab switching (Ctrl+Tab / Ctrl+Shift+Tab). Requires
  CONFIG_ZMK_POINTING for the scroll modes.

  Scroll is a CLEAN LINEAR stream of wheel line-deltas (d_scroll = ticks *
  scroll-units); the host smooth-scroll app (Mac Mouse Fix / Mos) owns smoothing
  and acceleration. There is intentionally no firmware acceleration. Base scroll
  speed = scroll-triggers-per-rotation (lines per revolution).

compatible: "zmk,behavior-encoder-dispatch"

properties:
  "#sensor-binding-cells":
    type: int
    required: true
    const: 0
  tap-ms:
    type: int
    default: 5
    description: |
      Key-hold duration queued per tick for the discrete key modes
      (volume & tabs: &kp press/release).
  scroll-units:
    type: int
    default: 1
    description: |
      Wheel line-delta emitted per scroll tick. Keep at 1 for a clean stream the
      host app can smooth; raising it multiplies base scroll speed.
  scroll-max-value:
    type: int
    default: 1000
    description: |
      Safety clamp on the per-report wheel magnitude (max int16 = 32767). Keeps a
      glitchy sensor read from emitting an enormous single scroll.
  scroll-min-interval-ms:
    type: int
    default: 12
    description: |
      Minimum gap between scroll HID reports. The sensor fires up to ~200 Hz on a
      fast spin; emitting a report per tick, sustained, wedges the USB HID TX path
      and hangs the board. Line-deltas are coalesced and emitted at most this
      often (12 ms ~= 83/s), carrying the remainder so no rotation is lost. macOS
      caps scroll rate and the host app smooths between reports, so it is
      imperceptible. 0 disables coalescing (one report per tick — may hang USB).
  volume-triggers-per-rotation:
    type: int
    default: 14
    description: |
      Volume steps per full turn. Low = coarse (a small turn = one volume step).
  tab-triggers-per-rotation:
    type: int
    default: 16
    description: |
      Tab switches per full turn in tab mode. Coarse so one notch ~= one tab; a
      small turn switches a single browser tab.
  scroll-triggers-per-rotation:
    type: int
    default: 80
    description: |
      Scroll ticks (line-deltas) per full turn = base scroll speed AND
      resolution. Lower = slower / coarser, higher = faster / finer. This is the
      main scroll-speed knob now that firmware acceleration is gone; the host app
      smooths between ticks, so a moderate value still feels smooth.
```

## firmware/zmk-config/module/dts/bindings/behaviors/zmk,behavior-encoder-mode-next.yaml
```yaml
description: |
  Encoder-mode-next behavior. On press, advances the current profile's encoder
  mode (volume -> vertical scroll -> horizontal scroll -> volume). Place on a
  regular key on any layer; the mode it changes is that of the active profile.

compatible: "zmk,behavior-encoder-mode-next"

include: zero_param.yaml
```

## firmware/zmk-config/module/dts/bindings/behaviors/zmk,behavior-profile-next.yaml
```yaml
description: |
  Profile-next behavior. On press, advances the active profile layer by one
  (modulo PROFILE_COUNT). Same binding can be placed on every layer — the
  cycle is computed from the current highest-active layer, so it doesn't
  depend on which layer's binding actually fires.

compatible: "zmk,behavior-profile-next"

include: zero_param.yaml
```

## firmware/zmk-config/module/dts/bindings/sensor/nikolas,as5600.yaml
```yaml
# Copyright (c) 2026 The ZMK Contributors
# SPDX-License-Identifier: MIT

description: |
  AS5600 12-bit magnetic rotary position sensor used as a ZMK keymap encoder.

  Distinct from the upstream Zephyr "ams,as5600" driver: this driver reports
  *rotation deltas in degrees* on SENSOR_CHAN_ROTATION (so ZMK's
  triggers-per-rotation controls the detent feel) and synthesises the
  SENSOR_TRIG_DATA_READY trigger ZMK's keymap-sensors subsystem requires by
  polling the RAW ANGLE register (0x0E/0x0F) over I2C on its own thread.

compatible: "nikolas,as5600"

include: [sensor-device.yaml, i2c-device.yaml]

properties:
  poll-period-ms:
    type: int
    default: 5
    description: |
      Interval at which the driver thread reads the magnet angle. Smaller =
      smoother/lower latency but more I2C traffic and less idle time.
```
